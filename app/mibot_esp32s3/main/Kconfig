## app/mibot_esp32s3/main/Kconfig
```kconfig
menu "Mibot DeepSeek smoke gateway"

config MIBOT_DEEPSEEK_GATEWAY
    bool "Enable the bounded DeepSeek HTTP gateway"
    default n
    help
        Accept 0x40 AI_REQUEST frames from the SF32 and asynchronously call
        DeepSeek's OpenAI-compatible chat completions endpoint. The API key
        is compiled from the local, ignored main/mibot_secrets.h file.
        Only one request is in flight, and the result is returned as one
        bounded 0x41 AI_RESPONSE frame.

endmenu

menu "Mibot experimental networking"

config MIBOT_NET_BRIDGE
    bool "Enable PPP-over-UART network bridge (experimental)"
    default n
    depends on LWIP_PPP_SUPPORT
    depends on LWIP_PPP_SERVER_SUPPORT
    depends on LWIP_PPP_ENABLE_IPV4
    help
        Add an isolated PPPoS server interface for the SF32 link.

        This option is intentionally off by default. The bridge uses a
        dedicated UART and never reads or writes the existing SF32 AA55
        protocol UART. The SF32 peer must run a PPP client; native SLIP is
        not enabled by this option.

config MIBOT_NET_BRIDGE_UART_NUM
    int "PPP bridge UART number"
    depends on MIBOT_NET_BRIDGE
    range 0 2
    default 1
    help
        ESP32 UART peripheral used exclusively by the PPP bridge. Do not
        select the UART used by the AA55/audio link or the console.

config MIBOT_NET_BRIDGE_UART_TX_GPIO
    int "PPP bridge UART TX GPIO"
    depends on MIBOT_NET_BRIDGE
    range 0 48
    default 17
    help
        GPIO routed to the dedicated PPP UART TX signal. Verify this against
        the carrier board schematic before enabling the bridge.

config MIBOT_NET_BRIDGE_UART_RX_GPIO
    int "PPP bridge UART RX GPIO"
    depends on MIBOT_NET_BRIDGE
    range 0 48
    default 18
    help
        GPIO routed to the dedicated PPP UART RX signal. Verify this against
        the carrier board schematic before enabling the bridge.

config MIBOT_NET_BRIDGE_UART_BAUD
    int "PPP bridge UART baud rate"
    depends on MIBOT_NET_BRIDGE
    range 9600 5000000
    default 1000000

config MIBOT_NET_BRIDGE_UART_RX_BUFFER
    int "PPP bridge UART RX buffer bytes"
    depends on MIBOT_NET_BRIDGE
    range 1024 65536
    default 8192

config MIBOT_NET_BRIDGE_UART_TX_BUFFER
    int "PPP bridge UART TX buffer bytes"
    depends on MIBOT_NET_BRIDGE
    range 1024 65536
    default 8192

config MIBOT_NET_BRIDGE_TASK_STACK
    int "PPP bridge task stack words"
    depends on MIBOT_NET_BRIDGE
    range 2048 16384
    default 4096

config MIBOT_NET_BRIDGE_LOCAL_IP
    string "PPP server IPv4 address"
    depends on MIBOT_NET_BRIDGE
    default "10.42.0.1"

config MIBOT_NET_BRIDGE_PEER_IP
    string "PPP peer IPv4 address"
    depends on MIBOT_NET_BRIDGE
    default "10.42.0.2"

config MIBOT_NET_BRIDGE_DNS1
    string "PPP DNS server IPv4 address"
    depends on MIBOT_NET_BRIDGE
    default "1.1.1.1"

config MIBOT_NET_BRIDGE_DNS2
    string "PPP secondary DNS server IPv4 address"
    depends on MIBOT_NET_BRIDGE
    default "8.8.8.8"

config MIBOT_NET_BRIDGE_NAPT
    bool "Enable NAPT on the PPP interface"
    depends on MIBOT_NET_BRIDGE
    depends on LWIP_IP_FORWARD
    depends on LWIP_IPV4_NAPT
    default n
    help
        Enable IPv4 NAPT after the PPP link comes up so the peer can use the
        ESP32 Wi-Fi interface as its upstream route. This is a separate
        policy choice and is deliberately not selected automatically.

config MIBOT_SHARED_NET_BRIDGE
    bool "Enable raw IPv4 bridge on the AA55 UART (experimental)"
    default n
    depends on LWIP_IPV4
    depends on !MIBOT_NET_BRIDGE
    help
        Route-A transport using the existing SF32 AA55/audio UART. Each
        0x70/0x71 AA55 payload carries one complete IPv4 packet. The ESP32
        exposes a static vanilla lwIP interface; no PPP, LCP, IPCP, SLIP, or
        Ethernet/ARP bytes are put on the wire. The controller continues to
        own AA55 framing, CRC and UART locking.

config MIBOT_SHARED_NET_MAX_PACKET
    int "Maximum raw IPv4 packet bytes"
    depends on MIBOT_SHARED_NET_BRIDGE
    range 576 4096
    default 1600
    help
        Maximum complete IPv4 packet accepted on the shared UART. Keep this
        above the configured MTU and below the AA55 payload limit.

config MIBOT_SHARED_NET_RX_QUEUE_DEPTH
    int "Raw IPv4 RX queue depth"
    depends on MIBOT_SHARED_NET_BRIDGE
    range 2 64
    default 8

config MIBOT_SHARED_NET_TX_QUEUE_DEPTH
    int "Raw IPv4 TX queue depth"
    depends on MIBOT_SHARED_NET_BRIDGE
    range 2 64
    default 8

config MIBOT_SHARED_NET_TASK_STACK
    int "Raw IPv4 worker stack words"
    depends on MIBOT_SHARED_NET_BRIDGE
    range 2048 16384
    default 3072

config MIBOT_SHARED_NET_LOCAL_IP
    string "SF32 bridge local IPv4 address"
    depends on MIBOT_SHARED_NET_BRIDGE
    default "10.42.0.1"

config MIBOT_SHARED_NET_PEER_IP
    string "SF32 bridge peer IPv4 address"
    depends on MIBOT_SHARED_NET_BRIDGE
    default "10.42.0.2"

config MIBOT_SHARED_NET_NETMASK
    string "SF32 bridge IPv4 netmask"
    depends on MIBOT_SHARED_NET_BRIDGE
    default "255.255.255.252"

config MIBOT_SHARED_NET_MTU
    int "SF32 bridge IPv4 MTU"
    depends on MIBOT_SHARED_NET_BRIDGE
    range 576 2000
    default 1200

config MIBOT_SHARED_NET_NAPT
    bool "Enable NAPT for raw IPv4 bridge"
    depends on MIBOT_SHARED_NET_BRIDGE
    depends on LWIP_IP_FORWARD
    depends on LWIP_IPV4_NAPT
    default y
    help
        Enable IPv4 NAPT on the raw SF32 interface so SF32 traffic can use the
        ESP32 Wi-Fi station as its upstream route. Also enable LWIP_IP_FORWARD
        and LWIP_IPV4_NAPT in the lwIP configuration.

endmenu
```

## app/mibot_voice_agent/Kconfig
```kconfig
# SPDX-License-Identifier: Apache-2.0

config EXAMPLES_MIBOT_AGENT
	tristate "Mibot SF32 agent"
	default n
	depends on NSH_BUILTIN_APPS && !EXAMPLES_AI_AGENT_VELA
	select PTHREAD
	---help---
		Run the Mibot SF32 agent. The agent is the sole mibot_link owner:
		it owns the UART2 protocol, state machine, framebuffer status
		renderer and optional I2S audio bridge for the SF32LB52-DevKit-LCD.
		Control and audio frames are multiplexed on the same UART.

if EXAMPLES_MIBOT_AGENT

config EXAMPLES_MIBOT_AGENT_PROGNAME
	string "Program name"
	default "mibot_agent"

config EXAMPLES_MIBOT_AGENT_PRIORITY
	int "Task priority"
	default 120

config EXAMPLES_MIBOT_AGENT_STACKSIZE
	int "Task stack size"
	default 8192

config EXAMPLES_MIBOT_AGENT_UART
	string "ESP32 UART device"
	default "/dev/ttyS0"

config EXAMPLES_MIBOT_AGENT_BAUD
	int "ESP32 UART baud rate"
	default 1000000

config EXAMPLES_MIBOT_AGENT_FB
	string "Framebuffer device"
	default "/dev/fb0"

config EXAMPLES_MIBOT_AGENT_AUDIO
	bool "Enable optional audio bridge"
	default n
	depends on AUDIO
	---help---
		Enable the audio bridge only after a board-specific SF32
		AUDCODEC/AUDPRC NuttX lower-half has been registered. The
		DevKit-LCD uses the on-chip 24-bit audio ADC/DAC and PA10
		amplifier enable; it is not an external I2S codec.

config EXAMPLES_MIBOT_AGENT_AUDIO_HW
	bool "Initialize on-chip SF32 audio analog paths"
	default n
	depends on EXAMPLES_MIBOT_AGENT
	---help---
		Initialize the SF32LB52X on-chip AUDCODEC ADC/DAC analog
		paths (including MIC bias). This is a hardware bring-up
		step and does not register a NuttX streaming audio device.

config EXAMPLES_SF32_AUDIO_TEST
	bool "SF32 audio test command"
	default y
	depends on EXAMPLES_MIBOT_AGENT && I2S

config EXAMPLES_AUDIO_PBT
	bool "Audio frame conversion tests"
	default y
	depends on EXAMPLES_MIBOT_AGENT
	---help---
		Register the audio_pbt command.  It exercises
		sf_compact_frame() and sf_expand_frame() with no codec,
		DMA or UART involved, so a padded-layout regression can
		be caught on target without wiring up audio hardware.

# Kept hidden so old defconfigs are normalized without exposing an unsupported
# second-UART transport.  mibot_agent/mibot_link must remain the sole owner of
# /dev/ttyS0; network access is provided by the ESP32 side of that link.
config EXAMPLES_MIBOT_ROUTE_A_PPP
	bool
	default n
	depends on n


endif

config EXAMPLES_DEEPSEEK_SMOKE
	bool "DeepSeek UART smoke test"
	default n
	depends on NSH_BUILTIN_APPS && !EXAMPLES_MIBOT_AGENT && !EXAMPLES_AI_AGENT_VELA
	---help---
		Run a one-shot AA55 HELLO/AI_REQUEST/AI_RESPONSE check against the
		ESP32 DeepSeek gateway. This intentionally owns /dev/ttyS0 by itself;
		do not enable mibot_agent or ai_agent in the same image.

if EXAMPLES_DEEPSEEK_SMOKE

config EXAMPLES_DEEPSEEK_SMOKE_UART
	string "DeepSeek smoke UART device"
	default "/dev/ttyS0"

config EXAMPLES_DEEPSEEK_SMOKE_BAUD
	int "DeepSeek smoke UART baud rate"
	default 1000000

endif

config EXAMPLES_MIBOT_VOICE_AGENT
	bool "Mibot voice agent (6-state dialog main state machine)"
	default n
	depends on NSH_BUILTIN_APPS && !EXAMPLES_MIBOT_AGENT && !EXAMPLES_DEEPSEEK_SMOKE && !EXAMPLES_AI_AGENT_VELA
	select PTHREAD
	---help---
		Run the standalone Mibot voice agent. It owns the 6-state dialog
		main state machine (IDLE/LISTENING/THINKING/ACTING/SPEAKING/
		SAFE_STOP) on the SF32 side, drives the LCD, board audio and the
		DeepSeek + native tool-call round-trip, and forwards robot.*
		commands to the ESP32 over the shared AA55/CRC UART. It
		intentionally owns /dev/ttyS0 by itself; do not enable mibot_agent,
		deepseek_smoke or ai_agent in the same image. First version runs in
		all-stub mode (ASR/TTS/ToF stubbed) and Sequential_Mode.

if EXAMPLES_MIBOT_VOICE_AGENT

config EXAMPLES_MIBOT_VOICE_AGENT_PROGNAME
	string "Program name"
	default "mibot_voice_agent"

config EXAMPLES_MIBOT_VOICE_AGENT_PRIORITY
	int "Task priority"
	default 120

config EXAMPLES_MIBOT_VOICE_AGENT_STACKSIZE
	int "Task stack size"
	default 12288

config EXAMPLES_MIBOT_VOICE_AGENT_UART
	string "ESP32 UART device"
	default "/dev/ttyS0"

config EXAMPLES_MIBOT_VOICE_AGENT_BAUD
	int "ESP32 UART baud rate"
	default 1000000

config EXAMPLES_MIBOT_VOICE_AGENT_FB
	string "Framebuffer device"
	default "/dev/fb0"

config EXAMPLES_MIBOT_VOICE_AGENT_BUTTON
	string "Wake button device"
	default "/dev/buttons"
	---help---
		Physical dialog trigger, equivalent to the va_wake NSH command.
		On the SF32LB52-DevKit-LCD this is KEY2 on PA11 (active high),
		served by the board's sf32lb52_buttons driver.  Requires
		CONFIG_INPUT and CONFIG_INPUT_BUTTONS; leave the string empty to
		build without a physical trigger.

		PA34 is deliberately not usable here: it is the power key wired
		into the reset path, and the board leaves its pinmux disabled.

endif
```
